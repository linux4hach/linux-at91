## Documentation/devicetree/bindings/cpufreq/cpufreq-at91.txt
```
AT91 cpufreq driver
-------------------

AT91 SoC cpufreq driver for CPU frequency scaling.

Required properties:
- operating-points: Table of frequencies and voltage CPU could be transitioned into,
	in the increasing order. Frequency should be in KHz units and voltage
	should be in microvolts.

- atmel,cpufreq_regs_setting:An array of 4-tuples items, and each item consists
	of frequency, ddram controller refresh timer register, pmc PLLA register
	and pmc master clock register setting
	like <freq-kHz ddramc_rtr ckgr_plla pmc_mckr>
		freq: clock frequency in kHz

Optional properties:
- clock-latency: Clock monitor latency in microsecond.

All the required listed above must be defined under node cpufreq.

Example:
--------
/ {
	<...>

	cpus {
		#address-cells = <1>;
		#size-cells = <0>;
		cpu@0 {
			device_type = "cpu";
			compatible = "arm,cortex-a5";
			reg = <0x0>;
			operating-points = <
				/* kHz    uV */
				528000  1300000
				396000	1200000
				264000	1100000
			>;
			clock-latency = <100000>;
			atmel,cpufreq_regs_setting = <
				/* kHz      rtr      pllar  mckr */
				528000 0x300080 0x20ac3f01 0x200
				396000 0x300080 0x21043f01 0x1300
				264000 0x300080 0x20ac3f01 0x1100
			>;
		};
	};
};
```

## arch/arm/boot/dts/sama5d36ek_cmp.its
```
/*
 * Simple U-boot uImage source file containing a single kernel and FDT blob
 */

/dts-v1/;

/ {
	description = "Simple image with single Linux kernel and FDT blob";
	#address-cells = <1>;

	images {
		kernel@1 {
			description = "AT91 SAMA5D3 Linux kernel";
			data = /incbin/("../zImage");
			type = "kernel";
			arch = "arm";
			os = "linux";
			compression = "none";
			load = <0x20008000>;
			entry = <0x20008000>;
			hash@1 {
				algo = "crc32";
			};
		};
		fdt_sama5d36ek@1 {
			description = "Flattened Device Tree blob for SAMA5D36EK";
			data = /incbin/("./sama5d36ek.dtb");
			type = "flat_dt";
			arch = "arm";
			compression = "none";
			hash@1 {
				algo = "crc32";
			};
		};
		fdt_sama5d36ek@pda4 {
			description = "Flattened Device Tree blob for SAMA5D36EK with PDA4";
			data = /incbin/("./sama5d36ek_pda4.dtb");
			type = "flat_dt";
			arch = "arm";
			compression = "none";
			hash@1 {
				algo = "crc32";
			};
		};
		fdt_sama5d36ek@pda7 {
			description = "Flattened Device Tree blob for SAMA5D36EK with PDA7";
			data = /incbin/("./sama5d36ek_pda7.dtb");
			type = "flat_dt";
			arch = "arm";
			compression = "none";
			hash@1 {
				algo = "crc32";
			};
		};
		fdt_sama5d36ek_pm@1 {
			description = "Flattened Device Tree blob for SAMA5D36EK pm";
			data = /incbin/("./sama5d36ek_pm.dtb");
			type = "flat_dt";
			arch = "arm";
			compression = "none";
			hash@1 {
				algo = "crc32";
			};
		};
		fdt_sama5d36ek_gmac@1 {
			description = "Flattened Device Tree blob for SAMA5D36EK gmac";
			data = /incbin/("./sama5d36ek_gmac.dtb");
			type = "flat_dt";
			arch = "arm";
			compression = "none";
			hash@1 {
				algo = "crc32";
			};
		};
		fdt_sama5d36ek_dhrystone@1 {
			description = "Flattened Device Tree blob for SAMA5D36EK dhrystone";
			data = /incbin/("./sama5d36ek_dhrystone.dtb");
			type = "flat_dt";
			arch = "arm";
			compression = "none";
			hash@1 {
				algo = "crc32";
			};
		};
		fdt_sama5d36ek_lcd@1 {
			description = "Flattened Device Tree blob for SAMA5D36EK lcd";
			data = /incbin/("./sama5d36ek_lcd.dtb");
			type = "flat_dt";
			arch = "arm";
			compression = "none";
			hash@1 {
				algo = "crc32";
			};
		};
		fdt_sama5d36ek_pda4_lcd@1 {
			description = "Flattened Device Tree blob for SAMA5D36EK with PDA4 lcd";
			data = /incbin/("./sama5d36ek_pda4_lcd.dtb");
			type = "flat_dt";
			arch = "arm";
			compression = "none";
			hash@1 {
				algo = "crc32";
			};
		};
		fdt_sama5d36ek_pda7_lcd@1 {
			description = "Flattened Device Tree blob for SAMA5D36EK with PDA7 lcd";
			data = /incbin/("./sama5d36ek_pda7_lcd.dtb");
			type = "flat_dt";
			arch = "arm";
			compression = "none";
			hash@1 {
				algo = "crc32";
			};
		};
		fdt_sama5d36ek_usb@1 {
			description = "Flattened Device Tree blob for SAMA5D36EK usb";
			data = /incbin/("./sama5d36ek_usb.dtb");
			type = "flat_dt";
			arch = "arm";
			compression = "none";
			hash@1 {
				algo = "crc32";
			};
		};
		fdt_sama5d36ek_isi@1 {
			description = "Flattened Device Tree blob for SAMA5D36EK isi";
			data = /incbin/("./sama5d36ek_isi.dtb");
			type = "flat_dt";
			arch = "arm";
			compression = "none";
			hash@1 {
				algo = "crc32";
			};
		};
		fdt_sama5d36ek_pda4_isi@1 {
			description = "Flattened Device Tree blob for SAMA5D36EK with PDA4 isi";
			data = /incbin/("./sama5d36ek_pda4_isi.dtb");
			type = "flat_dt";
			arch = "arm";
			compression = "none";
			hash@1 {
				algo = "crc32";
			};
		};
		fdt_sama5d36ek_pda7_isi@1 {
			description = "Flattened Device Tree blob for SAMA5D36EK with PDA7 isi";
			data = /incbin/("./sama5d36ek_pda7_isi.dtb");
			type = "flat_dt";
			arch = "arm";
			compression = "none";
			hash@1 {
				algo = "crc32";
			};
		};
		fdt_sama5d36ek_audio@1 {
			description = "Flattened Device Tree blob for SAMA5D36EK audio";
			data = /incbin/("./sama5d36ek_audio.dtb");
			type = "flat_dt";
			arch = "arm";
			compression = "none";
			hash@1 {
				algo = "crc32";
			};
		};


		/* rev.C MB */
		fdt_sama5d36ek_revc@1 {
			description = "Flattened Device Tree blob for SAMA5D36EK rev.C";
			data = /incbin/("./sama5d36ek_revc.dtb");
			type = "flat_dt";
			arch = "arm";
			compression = "none";
			hash@1 {
				algo = "crc32";
			};
		};
		fdt_sama5d36ek_revc@pda4 {
			description = "Flattened Device Tree blob for SAMA5D36EK revC with PDA4";
			data = /incbin/("./sama5d36ek_revc_pda4.dtb");
			type = "flat_dt";
			arch = "arm";
			compression = "none";
			hash@1 {
				algo = "crc32";
			};
		};
		fdt_sama5d36ek_revc@pda7 {
			description = "Flattened Device Tree blob for SAMA5D36EK revC with PDA7";
			data = /incbin/("./sama5d36ek_revc_pda7.dtb");
			type = "flat_dt";
			arch = "arm";
			compression = "none";
			hash@1 {
				algo = "crc32";
			};
		};
		fdt_sama5d36ek_revc_isi@1 {
			description = "Flattened Device Tree blob for SAMA5D36EK revC isi";
			data = /incbin/("./sama5d36ek_revc_isi.dtb");
			type = "flat_dt";
			arch = "arm";
			compression = "none";
			hash@1 {
				algo = "crc32";
			};
		};
		fdt_sama5d36ek_revc_pda4_isi@1 {
			description = "Flattened Device Tree blob for SAMA5D36EK revC with PDA4 isi";
			data = /incbin/("./sama5d36ek_revc_pda4_isi.dtb");
			type = "flat_dt";
			arch = "arm";
			compression = "none";
			hash@1 {
				algo = "crc32";
			};
		};
		fdt_sama5d36ek_revc_pda7_isi@1 {
			description = "Flattened Device Tree blob for SAMA5D36EK revC with PDA7 isi";
			data = /incbin/("./sama5d36ek_revc_pda7_isi.dtb");
			type = "flat_dt";
			arch = "arm";
			compression = "none";
			hash@1 {
				algo = "crc32";
			};
		};
		fdt_sama5d36ek_revc_audio@1 {
			description = "Flattened Device Tree blob for SAMA5D36EK revC audio";
			data = /incbin/("./sama5d36ek_revc_audio.dtb");
			type = "flat_dt";
			arch = "arm";
			compression = "none";
			hash@1 {
				algo = "crc32";
			};
		};
	};

	configurations {
		default = "conf@sama5d36ek";

		conf@sama5d36ek {
			description = "Boot Linux kernel with SAMA5D36EK FDT blob";
			kernel = "kernel@1";
			fdt = "fdt_sama5d36ek@1";
		};
		conf@sama5d36ek_pda4 {
			description = "Boot Linux kernel with SAMA5D36EK PDA4 FDT blob";
			kernel = "kernel@1";
			fdt = "fdt_sama5d36ek@pda4";
		};
		conf@sama5d36ek_pda7 {
			description = "Boot Linux kernel with SAMA5D36EK PDA7 FDT blob";
			kernel = "kernel@1";
			fdt = "fdt_sama5d36ek@pda7";
		};
		conf@sama5d36ek_pm {
			description = "Boot Linux kernel with SAMA5D36EK pm FDT blob";
			kernel = "kernel@1";
			fdt = "fdt_sama5d36ek_pm@1";
		};
		conf@sama5d36ek_gmac {
			description = "Boot Linux kernel with SAMA5D36EK gmac FDT blob";
			kernel = "kernel@1";
			fdt = "fdt_sama5d36ek_gmac@1";
		};
		conf@sama5d36ek_dhrystone {
			description = "Boot Linux kernel with SAMA5D36EK dhrystone FDT blob";
			kernel = "kernel@1";
			fdt = "fdt_sama5d36ek_dhrystone@1";
		};
		conf@sama5d36ek_lcd {
			description = "Boot Linux kernel with SAMA5D36EK lcd FDT blob";
			kernel = "kernel@1";
			fdt = "fdt_sama5d36ek_lcd@1";
		};
		conf@sama5d36ek_pda4_lcd {
			description = "Boot Linux kernel with SAMA5D36EK PDA4 lcd FDT blob";
			kernel = "kernel@1";
			fdt = "fdt_sama5d36ek_pda4_lcd@1";
		};
		conf@sama5d36ek_pda7_lcd {
			description = "Boot Linux kernel with SAMA5D36EK PDA7 lcd FDT blob";
			kernel = "kernel@1";
			fdt = "fdt_sama5d36ek_pda7_lcd@1";
		};
		conf@sama5d36ek_usb {
			description = "Boot Linux kernel with SAMA5D36EK usb FDT blob";
			kernel = "kernel@1";
			fdt = "fdt_sama5d36ek_usb@1";
		};
		conf@sama5d36ek_isi {
			description = "Boot Linux kernel with SAMA5D36EK isi FDT blob";
			kernel = "kernel@1";
			fdt = "fdt_sama5d36ek_isi@1";
		};
		conf@sama5d36ek_pda4_isi {
			description = "Boot Linux kernel with SAMA5D36EK PDA4 isi FDT blob";
			kernel = "kernel@1";
			fdt = "fdt_sama5d36ek_pda4_isi@1";
		};
		conf@sama5d36ek_pda7_isi {
			description = "Boot Linux kernel with SAMA5D36EK PDA7 isi FDT blob";
			kernel = "kernel@1";
			fdt = "fdt_sama5d36ek_pda7_isi@1";
		};
		conf@sama5d36ek_audio {
			description = "Boot Linux kernel with SAMA5D36EK audio FDT blob";
			kernel = "kernel@1";
			fdt = "fdt_sama5d36ek_audio@1";
		};

		/* rev.C MB */
		conf@sama5d36ek_revc {
			description = "Boot Linux kernel with SAMA5D36EK rev.C FDT blob";
			kernel = "kernel@1";
			fdt = "fdt_sama5d36ek_revc@1";
		};
		conf@sama5d36ek_revc_pda4 {
			description = "Boot Linux kernel with SAMA5D36EK rev.C PDA4 FDT blob";
			kernel = "kernel@1";
			fdt = "fdt_sama5d36ek_revc@pda4";
		};
		conf@sama5d36ek_revc_pda7 {
			description = "Boot Linux kernel with SAMA5D36EK rev.C PDA7 FDT blob";
			kernel = "kernel@1";
			fdt = "fdt_sama5d36ek_revc@pda7";
		};
		conf@sama5d36ek_revc_isi {
			description = "Boot Linux kernel with SAMA5D36EK rev.C isi FDT blob";
			kernel = "kernel@1";
			fdt = "fdt_sama5d36ek_revc_isi@1";
		};
		conf@sama5d36ek_revc_pda4_isi {
			description = "Boot Linux kernel with SAMA5D36EK rev.C PAD4 isi FDT blob";
			kernel = "kernel@1";
			fdt = "fdt_sama5d36ek_revc_pda4_isi@1";
		};
		conf@sama5d36ek_revc_pda7_isi {
			description = "Boot Linux kernel with SAMA5D36EK rev.C PAD7 isi FDT blob";
			kernel = "kernel@1";
			fdt = "fdt_sama5d36ek_revc_pda7_isi@1";
		};
		conf@sama5d36ek_revc_audio {
			description = "Boot Linux kernel with SAMA5D36EK rev.C audio FDT blob";
			kernel = "kernel@1";
			fdt = "fdt_sama5d36ek_revc_audio@1";
		};
	};
};
```

## arch/arm/configs/hach-at91sam9g35_defconfig
```kconfig
# CONFIG_LOCALVERSION_AUTO is not set
# CONFIG_SWAP is not set
CONFIG_SYSVIPC=y
CONFIG_LOG_BUF_SHIFT=14
CONFIG_BLK_DEV_INITRD=y
CONFIG_CC_OPTIMIZE_FOR_SIZE=y
CONFIG_KALLSYMS_ALL=y
CONFIG_EMBEDDED=y
CONFIG_PERF_EVENTS=y
CONFIG_SLAB=y
CONFIG_MODULES=y
CONFIG_MODULE_UNLOAD=y
# CONFIG_BLK_DEV_BSG is not set
# CONFIG_IOSCHED_DEADLINE is not set
# CONFIG_IOSCHED_CFQ is not set
CONFIG_ARCH_AT91=y
CONFIG_KEXEC=y
CONFIG_CPU_IDLE=y
# CONFIG_CORE_DUMP_DEFAULT_ELF_HEADERS is not set
CONFIG_NET=y
CONFIG_PACKET=y
CONFIG_UNIX=y
CONFIG_INET=y
CONFIG_IP_MULTICAST=y
CONFIG_IP_PNP=y
CONFIG_IP_PNP_DHCP=y
CONFIG_IP_PNP_BOOTP=y
CONFIG_IP_PNP_RARP=y
# CONFIG_INET_XFRM_MODE_TRANSPORT is not set
# CONFIG_INET_XFRM_MODE_TUNNEL is not set
# CONFIG_INET_XFRM_MODE_BEET is not set
# CONFIG_INET_DIAG is not set
CONFIG_IPV6=y
# CONFIG_INET6_XFRM_MODE_TRANSPORT is not set
# CONFIG_INET6_XFRM_MODE_TUNNEL is not set
# CONFIG_INET6_XFRM_MODE_BEET is not set
CONFIG_IPV6_SIT_6RD=y
CONFIG_CFG80211=y
CONFIG_MAC80211=y
CONFIG_UEVENT_HELPER_PATH="/sbin/hotplug"
CONFIG_DEVTMPFS=y
CONFIG_DEVTMPFS_MOUNT=y
# CONFIG_STANDALONE is not set
# CONFIG_PREVENT_FIRMWARE_BUILD is not set
CONFIG_MTD=y
CONFIG_MTD_CMDLINE_PARTS=y
CONFIG_MTD_BLOCK=y
CONFIG_MTD_DATAFLASH=y
CONFIG_MTD_M25P80=y
CONFIG_MTD_NAND=y
CONFIG_MTD_UBI=y
CONFIG_MTD_UBI_GLUEBI=y
CONFIG_BLK_DEV_LOOP=y
CONFIG_BLK_DEV_RAM=y
CONFIG_BLK_DEV_RAM_COUNT=4
CONFIG_BLK_DEV_RAM_SIZE=8192
CONFIG_SCSI=y
CONFIG_BLK_DEV_SD=y
CONFIG_SCSI_MULTI_LUN=y
# CONFIG_SCSI_LOWLEVEL is not set
CONFIG_NETDEVICES=y
# CONFIG_NET_VENDOR_BROADCOM is not set
# CONFIG_NET_VENDOR_INTEL is not set
# CONFIG_NET_VENDOR_MARVELL is not set
# CONFIG_NET_VENDOR_MICREL is not set
# CONFIG_NET_VENDOR_NATSEMI is not set
# CONFIG_NET_VENDOR_SEEQ is not set
# CONFIG_NET_VENDOR_SMSC is not set
# CONFIG_NET_VENDOR_STMICRO is not set
CONFIG_PHYLIB=y
CONFIG_DAVICOM_PHY=y
CONFIG_MICREL_PHY=y
CONFIG_RTL8187=m
CONFIG_LIBERTAS=m
CONFIG_LIBERTAS_SDIO=m
CONFIG_LIBERTAS_SPI=m
CONFIG_RT2X00=m
CONFIG_RT2500USB=m
CONFIG_RT73USB=m
CONFIG_RT2800USB=m
CONFIG_RT2800USB_RT53XX=y
CONFIG_RT2800USB_RT55XX=y
CONFIG_RT2800USB_UNKNOWN=y
CONFIG_RTL8192CU=m
# CONFIG_RTLWIFI_DEBUG is not set
CONFIG_MWIFIEX=m
CONFIG_MWIFIEX_SDIO=m
CONFIG_MWIFIEX_USB=m
CONFIG_INPUT_POLLDEV=y
# CONFIG_INPUT_MOUSEDEV_PSAUX is not set
CONFIG_INPUT_MOUSEDEV_SCREEN_X=480
CONFIG_INPUT_MOUSEDEV_SCREEN_Y=272
CONFIG_INPUT_JOYDEV=y
CONFIG_INPUT_EVDEV=y
# CONFIG_KEYBOARD_ATKBD is not set
CONFIG_KEYBOARD_GPIO=y
# CONFIG_INPUT_MOUSE is not set
CONFIG_INPUT_TOUCHSCREEN=y
CONFIG_TOUCHSCREEN_ADS7846=y
# CONFIG_SERIO is not set
CONFIG_LEGACY_PTY_COUNT=4
CONFIG_HW_RANDOM=y
CONFIG_I2C_CHARDEV=y
CONFIG_I2C_GPIO=y
CONFIG_I2C_PARPORT_LIGHT=y
CONFIG_SPI=y
CONFIG_SPI_DEBUG=y
CONFIG_SPI_BITBANG=y
CONFIG_SPI_SPIDEV=y
CONFIG_GPIO_SYSFS=y
CONFIG_POWER_SUPPLY=y
# CONFIG_HWMON is not set
CONFIG_THERMAL=y
CONFIG_THERMAL_GOV_USER_SPACE=y
CONFIG_WATCHDOG=y
CONFIG_WATCHDOG_CORE=y
CONFIG_SSB=m
CONFIG_DRM=y
CONFIG_FB=y
CONFIG_FB_MODE_HELPERS=y
CONFIG_BACKLIGHT_LCD_SUPPORT=y
# CONFIG_LCD_CLASS_DEVICE is not set
CONFIG_BACKLIGHT_CLASS_DEVICE=y
# CONFIG_BACKLIGHT_GENERIC is not set
CONFIG_BACKLIGHT_PWM=y
CONFIG_FRAMEBUFFER_CONSOLE=y
CONFIG_FRAMEBUFFER_CONSOLE_DETECT_PRIMARY=y
CONFIG_LOGO=y
CONFIG_SOUND=y
CONFIG_SND=y
CONFIG_SND_SOC=y
CONFIG_SND_ATMEL_SOC=y
CONFIG_SND_SOC_WM8731=y
CONFIG_USB=y
CONFIG_USB_ANNOUNCE_NEW_DEVICES=y
CONFIG_USB_EHCI_HCD=y
CONFIG_USB_OHCI_HCD=y
CONFIG_USB_ACM=y
CONFIG_USB_STORAGE=y
CONFIG_USB_SERIAL=y
CONFIG_USB_SERIAL_GENERIC=y
CONFIG_USB_SERIAL_FTDI_SIO=y
CONFIG_USB_SERIAL_PL2303=y
CONFIG_USB_GADGET=y
CONFIG_USB_G_SERIAL=y
CONFIG_MMC=y
CONFIG_MMC_SPI=y
CONFIG_NEW_LEDS=y
CONFIG_LEDS_CLASS=y
CONFIG_LEDS_GPIO=y
CONFIG_LEDS_TRIGGERS=y
CONFIG_LEDS_TRIGGER_TIMER=y
CONFIG_LEDS_TRIGGER_HEARTBEAT=y
CONFIG_LEDS_TRIGGER_GPIO=y
CONFIG_RTC_CLASS=y
CONFIG_RTC_DRV_RV3029C2=y
CONFIG_DMADEVICES=y
# CONFIG_IOMMU_SUPPORT is not set
CONFIG_IIO=y
CONFIG_AT91_ADC=y
CONFIG_PWM=y
CONFIG_EXT4_FS=y
CONFIG_FANOTIFY=y
CONFIG_VFAT_FS=y
CONFIG_TMPFS=y
CONFIG_JFFS2_FS=y
CONFIG_JFFS2_SUMMARY=y
CONFIG_UBIFS_FS=y
CONFIG_UBIFS_FS_ADVANCED_COMPR=y
CONFIG_NFS_FS=y
CONFIG_ROOT_NFS=y
CONFIG_NLS_CODEPAGE_437=y
CONFIG_NLS_CODEPAGE_850=y
CONFIG_NLS_ISO8859_1=y
CONFIG_NLS_UTF8=y
CONFIG_STRIP_ASM_SYMS=y
CONFIG_DEBUG_FS=y
# CONFIG_SCHED_DEBUG is not set
# CONFIG_DEBUG_BUGVERBOSE is not set
# CONFIG_FTRACE is not set
CONFIG_CRYPTO_ECB=y
# CONFIG_CRYPTO_ANSI_CPRNG is not set
CONFIG_CRYPTO_USER_API_HASH=m
CONFIG_CRYPTO_USER_API_SKCIPHER=m
# CONFIG_CRYPTO_HW is not set
CONFIG_CRC_CCITT=y
CONFIG_FONTS=y
CONFIG_FONT_8x8=y
CONFIG_FONT_ACORN_8x8=y
CONFIG_FONT_MINI_4x6=y
```
